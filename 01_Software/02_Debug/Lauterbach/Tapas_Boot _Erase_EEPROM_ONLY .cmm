; ***************************************************************************
; ***************************************************************************
; (C) 2016 SIGRA Technologies GmbH  All rights reserved.
; 
; All data and information contained in or disclosed by this document is
; confidential and proprietary information of SIGRA Technologies GmbH and all
; rights therein are expressly reserved.  By accepting this material the
; recipient agrees that this material and the information contained therein
; is held in confidence and in trust and will not be used, copied, reproduced
; in whole or in part, nor its contents revealed in any manner to others
; without the express written permission of SIGRA Technologies GmbH
; 
; SIGRA Technologies GmbH
; Agnes-Pockels-Bogen 1,
; 80992, Munich,
; Germany
; 
; File Name: tapas.cmm
; Author: Karim Mansour 
; E-mail: karim@sigratech.de 
; ***************************************************************************
; ***************************************************************************

; Make sure the system is down before flashing
  SYStem.Down

  ; --------------------------------------------------------------------------------
  ; Setup script configuration. If auto ECC generation is disabled then
  ; flash sectors are programmed without generating ECC. ECC sectors can be
  ; programmed separately or ECC sector programming can be omitted.

  LOCAL &parameters
  ENTRY %LINE &parameters

  LOCAL &param_prepareonly
  &param_prepareonly=(STRing.SCAN(STRing.UPpeR("&parameters"),"PREPAREONLY",0)!=-1)

  LOCAL &AutoECCGeneration
  &AutoECCGeneration=STRing.SCANAndExtract(STRing.UPpeR("&parameters"),"AUTOECC=","1")

  LOCAL &param_dualport
  &param_dualport=0
  IF VERSION.BUILD.BASE()>=43441.
    &param_dualport=STRing.SCANAndExtract(STRing.UPpeR("&parameters"),"DUALPORT=","0")

  ; --------------------------------------------------------------------------------
  ; Setup CPU

  IF SYStem.MODE()<5
  (
    SYStem.RESet
    MAP.RESet

    SYStem.CPU TMS570LS3137-ZWT
    ETM.OFF
    SYStem.Up
  )

  ; --------------------------------------------------------------------------------
  ; Flash declaration

  FLASH.RESet

  IF &AutoECCGeneration!=0
  (
    ; Program flash
    FLASH.Create  1. 0x00000000--0x0001FFFF  0x8000 TARGET Byte 0.  ; Bank 0
    FLASH.Create  2. 0x00020000--0x0017FFFF 0x20000 TARGET Byte 0.  ; Bank 0
    FLASH.Create  3. 0x00180000--0x002FFFFF 0x20000 TARGET Byte 1.  ; Bank 1
    ; EEPROM emulation flash
    FLASH.Create  8. 0xF0200000--0xF020FFFF  0x4000 TARGET Byte 7.  ; Bank 7

    IF &param_dualport==0
      FLASH.TARGET 0x08000000 0x08001000 0x4000 ~~/demo/arm/flash/byte_be/f021r4.bin
    ELSE
      FLASH.TARGET 0x08000000 EAHB:0x08001000 0x4000 ~~/demo/arm/flash/byte_be/f021r4.bin /DualPort
  )
  ELSE
  (
    ; Program flash
    FLASH.Create  1. 0x00000000--0x0001FFFF  0x8000 TARGET Byte 0. /EraseALIAS 0xf0400000--0xf0403FFF  ; Bank 0
    FLASH.Create  2. 0x00020000--0x0017FFFF 0x20000 TARGET Byte 0. /EraseALIAS 0xf0404000--0xf042FFFF  ; Bank 0
    FLASH.Create  3. 0x00180000--0x002FFFFF 0x20000 TARGET Byte 1. /EraseALIAS 0xf0430000--0xf045FFFF  ; Bank 1
    ; Program flash ECC
    FLASH.Create  1. 0xF0400000--0xF0403FFF  0x1000 TARGET Byte 0. /EraseALIAS 0x00000000--0x0001FFFF  ; Bank 0
    FLASH.Create  2. 0xF0404000--0xF042FFFF  0x4000 TARGET Byte 0. /EraseALIAS 0x00020000--0x0017FFFF  ; Bank 0
    FLASH.Create  3. 0xF0430000--0xF045FFFF  0x4000 TARGET Byte 1. /EraseALIAS 0x00180000--0x002FFFFF  ; Bank 1
    ; EEPROM emulation flash
    FLASH.Create  8. 0xF0200000--0xF020FFFF  0x4000 TARGET Byte 7. /EraseALIAS 0xf0100000--0xf0101FFF  ; Bank 7
    ; EEPROM emulation flash ECC
    FLASH.Create  8. 0xF0100000--0xF0101FFF   0x800 TARGET Byte 7. /EraseALIAS 0xf0200000--0xf020FFFF  ; Bank 7

    IF &param_dualport==0
      FLASH.TARGET 0x08000000 0x08001000 0x4000 ~~/demo/arm/flash/byte_be/f021r4noecc.bin
    ELSE
      FLASH.TARGET 0x08000000 EAHB:0x08001000 0x4000 ~~/demo/arm/flash/byte_be/f021r4noecc.bin /DualPort
  )

  FLASH.CLocK.AUTO

  MAP.BUS16 0xF0400000--0xF045FFFF
  MAP.BUS16 0xF0100000--0xF0101FFF
  MAP.BUS16 0xF0040000--0xF0041FFF

  ; Flash script ends here if called with parameter PREPAREONLY
  IF &param_prepareonly
    ENDDO PREPAREDONE

  ; --------------------------------------------------------------------------------
  ; Flash programming example

  DIALOG.YESNO "Program flash memory?"
  LOCAL &progflash
  ENTRY &progflash

  IF &progflash 
  (
	FLASH.Erase 8.		
	
	; Basic setup
	  SYStem.RESet
	  SYStem.CPU TMS570LS3137-PGE
	  SYStem.Mode Attach
	  ;SYStem.Option DACR ON ;command locked!
	  SYStem.Option ResBreak OFF
	  SYStem.JtagClock 10Mhz
	  SYStem.Up 
    
	  Register.RESet
	  Data.LOAD.Elf ..\..\Flash_Debug\Exe\Tapas_Boot.out
	  
	  SYStem.RESetTarget
	  
	  SYStem.CpuAccess Enable
	  SYStem.MemAccess DAP
  )
  


  ENDDO
