; ***************************************************************************
; ***************************************************************************
; (C) 2016 SIGRA Technologies GmbH  All rights reserved.
; 
; All data and information contained in or disclosed by this document is
; confidential and proprietary information of SIGRA Technologies GmbH and all
; rights therein are expressly reserved.  By accepting this material the
; recipient agrees that this material and the information contained therein
; is held in confidence and in trust and will not be used, copied, reproduced
; in whole or in part, nor its contents revealed in any manner to others
; without the express written permission of SIGRA Technologies GmbH
; 
; SIGRA Technologies GmbH
; Agnes-Pockels-Bogen 1,
; 80992, Munich,
; Germany
; 
; File Name: tapas.cmm
; Author: Karim Mansour 
; E-mail: karim@sigratech.de 
; ***************************************************************************
; ***************************************************************************

; Make sure the system is down before flashing
  SYStem.Down

	;WinPAGE.RESet
	;AREA.RESet
	;WinPOS 0. 26. 75. 9. 0. 0. W000
	;AREA.view


	; Basic setup
	  SYStem.RESet
	  SYStem.CPU TMS570LS3137-PGE
	  SYStem.Mode Attach
	  ;SYStem.Option DACR ON ;command locked!
	  SYStem.Option ResBreak OFF
	  SYStem.JtagClock 10Mhz
	  SYStem.Up

	; Clear all windows
	;  WinCLEAR

	; Open some windows
	;  WinPOS 0% 0% 50% 50%
	;  List.auto

	;  WinPOS 50% 0% 50% 50%
	;  Register.view /SpotLight

	;  WinPOS 0% 50% 50% 50%
	;  Frame /Locals /Caller

	;  WinPOS 50% 50% 50% 50%
	;  Var.Watch
	;  Var.AddWatch ast; flags;


	; Load sieve demo application
	  Register.RESet
	  Data.LOAD.Elf ..\..\Flash_Debug\Exe\Tapas_Boot.out
	  ;Register.Set PC main
	  ;Register.Set R13 0x08008000
	  
	  SYStem.RESetTarget
	  
	  SYStem.CpuAccess Enable
	  SYStem.MemAccess DAP
  


  ENDDO
